## drivers/gpu/ion/Kconfig
```kconfig
menuconfig ION
	tristate "Ion Memory Manager"
	select GENERIC_ALLOCATOR
	select DMA_SHARED_BUFFER
	help
	  Chose this option to enable the ION Memory Manager.

config ION_TEGRA
	tristate "Ion for Tegra"
	depends on ARCH_TEGRA && ION
	help
	  Choose this option if you wish to use ion on an nVidia Tegra.

config ION_MSM
	tristate "Legacy Ion for MSM"
	depends on ARCH_MSM && ION
	help
	  Choose this option if you wish to use ion on an MSM target.

menuconfig ION_LEGACY
	tristate "Ion Memory Manager For pre 4.2 blobs"
	select GENERIC_ALLOCATOR
	select DMA_SHARED_BUFFER
	help
	  Chose this option to enable the Legacy ION Memory Manager.

config ION_MSM_LEGACY
	tristate "Legacy Ion for MSM"
	depends on ARCH_MSM && ION_LEGACY
	help
	  Choose this option if you wish to use ion on an MSM target.
```

## supercharger/Kconfig
```kconfig
config GT_L2_OC
	bool "1.3 ghz L2 Cache Boost Clock"
	default y
	help
	  This will enable L2 cache boost clock.

config GT_CPU_OC
	bool "1.4 ghz CPU Overclock"
	default y
	help
	  This will enable CPU overclocking.

config QUAD_CORES_SOC_STAT
	bool "Overall statistic details for quadcore SOCs"
	depends on CPU_FREQ_STAT
	default n
	help
	  This will show overall CPU frequency statistics via sysfs.
	  If this option is not set, it defaults to dual core stats

config MSM_CPUFREQ_LIMITER
	tristate "MSM CPU frequency limiter"
	default n
	help
	  This driver limits MSM CPU frequency through sysfs file system.

	  To compile this driver as a module, choose M here: the
	  module will be called cpufreq_stats.

	  If in doubt, say N.

config TURBO_BOOST
	bool "Enable CPU Turbo boost option"
	default y
	help
	  This option allows overclocking of 2 cores to higher clock rate
	  than stock maximum.  When more than 2 cores are active, the clock
	  is limited to stock max speeds


menu "Hotplug implementation type"

config INTELLI_PLUG
        bool "Enable intelli-plug cpu hotplug driver"
        default n
        help
          Generic Intelli-plug cpu hotplug driver for ARM SOCs

config CPUQUIET_FRAMEWORK
	bool "Cpuquiet framework"
	help
	  Cpuquiet implements pluggable policies for forcing cpu cores into a
	  quiescent state. Appropriate policies will save power without hurting
	  performance.

if CPUQUIET_FRAMEWORK

choice
	prompt "Default CPUQuiet governor"
	help
	  This option sets which CPUQuiet governor shall be loaded at
	  startup. If in doubt, select 'balanced'

config CPUQUIET_DEFAULT_GOV_BALANCED
	bool "balanced"
	select CPUQUIET_GOVERNOR_BALANCED
	depends on CPU_FREQ
	help
	  Use the CPUQuiet governor 'balanced' as default. This dynamically
	  scales the number of cpus online in the system based on the cpu
	  load

config CPUQUIET_DEFAULT_GOV_RUNNABLE
	bool "runnable"
	select CPUQUIET_GOVERNOR_RUNNABLE
	help
	  Use the CPUQuiet governor 'runnable' as default. This uses
	  the number of running threads ato scale the number of cpus  
	  online in the system
	  
config CPUQUIET_DEFAULT_GOV_RQ_STATS
	bool "rq_stats"
	select CPUQUIET_GOVERNOR_RQ_STATS
	help
	  Use the CPUQuiet governor 'rq_stats' as default. This uses
	  rq information to scale the number of cpus online in the system

config CPUQUIET_DEFAULT_GOV_LOAD_STATS
	bool "load_stats"
	select CPUQUIET_GOVERNOR_LOAD_STATS
	help
	  Use the CPUQuiet governor 'load_stats' as default
	  
endchoice

config CPUQUIET_GOVERNOR_BALANCED
	bool "balanced"
	depends on CPU_FREQ
	help
	  Add the CPUQuiet governor 'balanced'

config CPUQUIET_GOVERNOR_RUNNABLE
	bool "runnable"
	help
	  Add the CPUQuiet governor 'runnable'

config CPUQUIET_GOVERNOR_RQ_STATS
	bool "rq_stats"
	help
	  Add the CPUQuiet governor 'rq_stats'

config CPUQUIET_GOVERNOR_LOAD_STATS
	bool "load_stats"
	help
	  Add the CPUQuiet governor 'load_stats'

endif
endmenu 

choice
	prompt "MSM Thermal Monitor Types"
	default THERMAL_MONITOR

config INTELLI_THERMAL
	bool "Better thermal monitor for MSM"
	depends on THERMAL_TSENS8960 || THERMAL_TSENS8974
	depends on CPU_FREQ_MSM
	default n
	help
	  This enables thermal monitoring capability in the kernel replacing
	  userspace thermal monitoring altogether.

config THERMAL_MONITOR
	bool "Monitor thermal state and limit CPU Frequency"
	depends on THERMAL_TSENS8960 || THERMAL_TSENS8974
	depends on CPU_FREQ_MSM
	default n
	help
	  This enables thermal monitoring capability in the kernel in the
	  absence of a system wide thermal monitoring entity or until such an
	  entity starts running in the userspace. Monitors TSENS temperature
	  and limits the max frequency of the cores.

endchoice 

config GPU_OVERCLOCK
	bool "Enable GPU Overclocking 450MHZ option"
	default n
	help
	  APQ8064 GPU overclocking 

config HAS_MACH_MEMUTILS
	default y
	bool "Motorola MSM memcpy enhancements"
	help
	Faster memcpy performance for Krait

config COMPILE_WITH_LINARO_O3_OPTIMIZATIONS
       default n
       bool "build with O3 Maximum Optimization level"
       help
       Builds faster Code

config KERNEL_MODE_NEON
	bool "Support for NEON in kernel mode"
	default n
	depends on NEON && AEABI
	help
	  Say Y to include support for NEON in kernel mode.

config FORCE_FAST_CHARGE
	bool "Force AC charge mode at will"
	default y
	help
	  A simple sysfs interface to force adapters that
	  are detected as USB to charge as AC.
```
